## config/boards/shields/split/Kconfig.defconfig
```kconfig
config ZMK_BLE
	default y


config ZMK_USB
	default y

if SHIELD_SPLIT || SHIELD_SPLIT_LEFT || SHIELD_SPLIT_RIGHT

config ZMK_KEYBOARD_NAME
	default "split"

endif

config ZMK_SPLIT
	default y
```

## config/west.yml
```yaml
manifest:
  remotes:
    - name: zmkfirmware
      url-base: https://github.com/zmkfirmware
    - name: urob
      url-base: https://github.com/urob/zmk
  projects:
    - name: zmk
      remote: urob
      revision: mouse-keys
      import: app/west.yml
  self:
    path: config
```
